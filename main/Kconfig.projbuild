## main/Kconfig.projbuild
```kconfig
menu "Application Configuration"

    config NO_FAST_FUNCTIONS
        bool "Disable Fast Functions"
        default n
        help
            Disable fast function optimizations.

    config SWAP_COLORS
        bool "Swap Colors"
        default n
        help
            Swap RGB colors.

    choice COLOR_ORDER
        prompt "Pixel channel order (applied after Swap Colors)"
        default COLOR_ORDER_RGB
        help
            Remaps the R, G and B channels of every pixel at draw time, after
            the board's pin mapping and any SWAP_COLORS swap have been applied.
            Leave at RGB unless colors are wrong.

            This is a correction relative to the board's current output, not
            an absolute description of the panel: the value a panel needs
            depends on whether SWAP_COLORS is set. For example, a MatrixPortal
            S3 driving an original Tidbyt Gen1 panel needs SWAP_COLORS=y plus
            BGR, or equivalently SWAP_COLORS=n plus BRG.

            SWAP_COLORS applies one fixed pin permutation that differs per
            board - a green/blue exchange on MatrixPortal S3 and Tronbyt S3, a
            three-way rotation on Tidbyt Gen1, and no effect on other boards -
            so it can correct at most one channel order per board. Because this
            remaps data rather than pins, one setting behaves the same on every
            board. Also settable at runtime from the WiFi config portal or over
            the WebSocket.

        config COLOR_ORDER_RGB
            bool "RGB (standard)"

        config COLOR_ORDER_RBG
            bool "RBG"

        config COLOR_ORDER_GRB
            bool "GRB"

        config COLOR_ORDER_GBR
            bool "GBR"

        config COLOR_ORDER_BRG
            bool "BRG"

        config COLOR_ORDER_BGR
            bool "BGR"
    endchoice

    config NO_INVERT_CLOCK_PHASE
        bool "No Invert Clock Phase"
        default n
        help
            Do not invert clock phase. Required for some display panels (e.g., Tidbyt Gen2).

    config REFRESH_INTERVAL_SECONDS
        int "Default Refresh Interval (seconds)"
        default 10
        help
            Default time to show an app/image before refreshing.

    config ENABLE_AP_MODE
        bool "Enable AP Mode"
        default y
        help
            Enable WiFi Access Point mode for configuration when connection fails.

    config ENABLE_WIFI_POWER_SAVE
        bool "Enable WiFi Power Save"
        default n
        help
            Enable WiFi minimum modem power saving mode.

    config SKIP_DISPLAY_VERSION
        bool "Skip Display Version"
        default n
        help
            Skip displaying the firmware version on boot.

    config PREFER_IPV6
        bool "Prefer IPv6"
        default n
        help
            Prefer IPv6 for connections.

    config DISABLE_TOUCH_DEFAULT
        bool "Disable Touch By Default"
        default n
        help
            Disable the capacitive touch button by default (e.g., Tidbyt Gen2).
            Can still be toggled via NVS, WebSocket, or the config portal.

    config TOUCH_BEEP_DEFAULT
        bool "Beep On Touch By Default"
        default n
        help
            Play a short tone on the built-in speaker when the touch button
            is tapped or held (Tidbyt Gen2).
            Can still be toggled via NVS, WebSocket, or the config portal.

    config TOUCH_DOUBLE_TAP
        bool "Detect Double Tap"
        default n
        help
            Wait for a possible second tap before reporting a tap (Tidbyt Gen2).
            Double tap has no action assigned yet, and waiting for it delays
            every single tap by the double-tap window (500 ms), so a tap is
            reported as soon as the finger lifts unless this is enabled.

    config PATCH_I2S_DIVIDER
        bool "Patch HUB75 I2S Divider"
        default n
        help
            Patch the bundled ESP32-HUB75-MatrixPanel-DMA library to compute
            the I2S clock divider from the requested freq instead of using
            the upstream 2-or-4 lookup. Required on some Tidbyt Gen1 / Gen2
            displays that misbehave at the default rate; harmless to leave
            off if your panel works without it.

    config HTTP_BUFFER_SIZE_MAX
        int "Max HTTP Buffer Size"
        default 460000
        help
            Maximum size of the HTTP buffer.

    config HTTP_BUFFER_SIZE_DEFAULT
        int "Default HTTP Buffer Size"
        default 100000
        help
            Default size of the HTTP buffer.

    choice BOOT_ANIMATION
        prompt "Boot Animation"
        default BOOT_WEBP_TRONBYT

        config BOOT_WEBP_TRONBYT
            bool "Tronbyt"

        config BOOT_WEBP_WINDYTRON
            bool "Windytron"

        config BOOT_WEBP_PARROT
            bool "Parrot"
    endchoice

    choice BOARD_TYPE
        prompt "Board Type"
        default BOARD_TIDBYT_GEN1
        help
            Select the hardware board type.

        config BOARD_TIDBYT_GEN1
            bool "Tidbyt Gen 1"

        config BOARD_TIDBYT_GEN2
            bool "Tidbyt Gen 2"

        config BOARD_TRONBYT_S3
            bool "Tronbyt S3"

        config BOARD_TRONBYT_S3_WIDE
            bool "Tronbyt S3 Wide"

        config BOARD_PIXOTICKER
            bool "Pixoticker"

        config BOARD_MATRIXPORTAL_S3
            bool "MatrixPortal S3"

        config BOARD_MATRIXPORTAL_S3_WIDE
            bool "MatrixPortal S3 Wide (128x64)"

        config BOARD_WAVESHARE_S3
            bool "Waveshare ESP32-S3-RGB-Matrix"
    endchoice

    config PANEL_HEIGHT_64
        bool "64-row panel (64x64)"
        default n
        help
            Drive a 64x64 panel instead of the default 64x32. A 64x64 panel is
            wired exactly like a 64x32 one plus the E address line, so this is
            a property of the panel rather than of the board: set it on top of
            a board whose CH_E is wired to a real GPIO. Boards that fix their
            own geometry (the 128x64 ones) ignore it.

    config BUTTON_PIN
        int "Button Pin"
        default -1
        help
            GPIO pin for the button.

endmenu
```

## sdkconfig.defaults.matrixportal-s3-wide
```kconfig
CONFIG_IDF_TARGET="esp32s3"
# CONFIG_SWAP_COLORS is not set
CONFIG_NO_INVERT_CLOCK_PHASE=y
CONFIG_BOARD_MATRIXPORTAL_S3_WIDE=y
```

## sdkconfig.defaults.tidbyt-gen2
```kconfig
CONFIG_BOARD_TIDBYT_GEN2=y
CONFIG_NO_INVERT_CLOCK_PHASE=y
CONFIG_DISABLE_TOUCH_DEFAULT=y
```
